## board/eaton/am335x_genepi/Kconfig
```kconfig
if TARGET_AM335X_GENEPI

config SYS_BOARD
	default "am335x_genepi"

config SYS_VENDOR
	default "eaton"

config SYS_SOC
	default "am33xx"

config SYS_CONFIG_NAME
	default "am335x_genepi"

config CONS_INDEX
	int "UART used for console"
	range 1 6
	default 5
	help
	  The AM335x SoC has a total of 6 UARTs (UART0 to UART5 as referenced
	  in documentation, etc) available to it.  Depending on your specific
	  board you may want something other than UART0 as for example the IDK
	  uses UART3 so enter 4 here.

config NOR
	bool "Support for NOR flash"
	help
	  The AM335x SoC supports having a NOR flash connected to the GPMC.
	  In practice this is seen as a NOR flash module connected to the
	  "memory cape" for the BeagleBone family.

source "board/ti/common/Kconfig"

endif
```

## configs/am335x_boneblack_defconfig
```kconfig
CONFIG_ARM=y
CONFIG_ARCH_OMAP2PLUS=y
CONFIG_TI_COMMON_CMD_OPTIONS=y
CONFIG_AM33XX=y
CONFIG_SPL=y
CONFIG_DISTRO_DEFAULTS=y
CONFIG_SYS_EXTRA_OPTIONS="ENV_IS_NOWHERE"
CONFIG_SYS_CONSOLE_INFO_QUIET=y
CONFIG_VERSION_VARIABLE=y
CONFIG_ARCH_MISC_INIT=y
CONFIG_SPL=y
CONFIG_SPL_STACK_R=y
# CONFIG_SPL_MUSB_NEW_SUPPORT is not set
CONFIG_SPL_OS_BOOT=y
CONFIG_AUTOBOOT_KEYED=y
CONFIG_AUTOBOOT_PROMPT="Press SPACE to abort autoboot in %d seconds\n"
CONFIG_AUTOBOOT_DELAY_STR="d"
CONFIG_AUTOBOOT_STOP_STR=" "
CONFIG_CMD_SPL=y
# CONFIG_CMD_FLASH is not set
 CONFIG_CMD_GPT is not set
CONFIG_CMD_MMC=y
# CONFIG_CMD_SF is not set
# CONFIG_CMD_SPI is not set
CONFIG_CMD_I2C=y
# CONFIG_CMD_USB is not set
# CONFIG_CMD_DFU is not set
CONFIG_CMD_GPIO=y
# CONFIG_CMD_SETEXPR is not set
# CONFIG_CMD_EXT4_WRITE is not set
# CONFIG_DFU_TFTP is not set
# CONFIG_DFU_MMC is not set
# CONFIG_DFU_RAM is not set
CONFIG_MMC_OMAP_HS=y
# CONFIG_SPI_FLASH is not set
# CONFIG_SPI_FLASH_WINBOND is not set
CONFIG_SYS_NS16550=y
# CONFIG_USB is not set
# CONFIG_USB_MUSB_HOST is not set
# CONFIG_USB_MUSB_GADGET is not set
# CONFIG_USB_STORAGE is not set
# CONFIG_USB_GADGET is not set
# CONFIG_USB_GADGET_DOWNLOAD is not set
# CONFIG_G_DNL_MANUFACTURER="Texas Instruments"
# CONFIG_G_DNL_VENDOR_NUM=0x0451
# CONFIG_G_DNL_PRODUCT_NUM=0xd022
CONFIG_OF_LIBFDT=y
```

## configs/am335x_genepi_defconfig
```kconfig
CONFIG_ARM=y
CONFIG_ARCH_OMAP2PLUS=y
CONFIG_AM33XX=y
CONFIG_TARGET_AM335X_GENEPI=y
CONFIG_DEFAULT_DEVICE_TREE="am335x-io2200"
# CONFIG_SPL_NAND_SUPPORT is not set
CONFIG_SPL_STACK_R_ADDR=0x82000000
CONFIG_DISTRO_DEFAULTS=y
CONFIG_SYS_EXTRA_OPTIONS="SPI_BOOT ENV_IS_NOWHERE"
CONFIG_SYS_CONSOLE_INFO_QUIET=y
CONFIG_VERSION_VARIABLE=y
CONFIG_ARCH_MISC_INIT=y
CONFIG_FIT=y
CONFIG_FIT_SIGNATURE=y
CONFIG_RSA=y
CONFIG_OF_CONTROL=y
CONFIG_OF_SEPARATE=y
CONFIG_SPL=y
CONFIG_SPL_STACK_R=y
# CONFIG_SPL_MUSB_NEW_SUPPORT is not set
# CONFIG_SPL_OS_BOOT is not set
CONFIG_AUTOBOOT_KEYED=y
CONFIG_AUTOBOOT_PROMPT="Press SPACE to abort autoboot in %d seconds\n"
CONFIG_AUTOBOOT_DELAY_STR="d"
CONFIG_AUTOBOOT_STOP_STR=" "
# CONFIG_CMD_IMLS is not set
CONFIG_CMD_ASKENV=y
CONFIG_CMD_FLASH=y
# CONFIG_CMD_GPT is not set
CONFIG_CMD_MMC=y
CONFIG_CMD_SF=y
CONFIG_CMD_SPI=y
#CONFIG_CMD_I2C
# CONFIG_CMD_USB is not set
# CONFIG_CMD_DFU is not set
CONFIG_CMD_GPIO=y
CONFIG_CMD_SETEXPR=y
# CONFIG_CMD_EXT4_WRITE is not set
# CONFIG_DFU_TFTP is not set
# CONFIG_DFU_MMC is not set
# CONFIG_DFU_RAM is not set
CONFIG_MMC_OMAP_HS=y
CONFIG_SYS_NS16550=y
# CONFIG_USB is not set
# CONFIG_USB_MUSB_HOST is not set
# CONFIG_USB_MUSB_GADGET is not set
# CONFIG_USB_STORAGE is not set
# CONFIG_USB_GADGET is not set
# CONFIG_USB_GADGET_DOWNLOAD is not set
# CONFIG_G_DNL_MANUFACTURER="Texas Instruments"
# CONFIG_G_DNL_VENDOR_NUM=0x0451
# CONFIG_G_DNL_PRODUCT_NUM=0xd022
CONFIG_OF_LIBFDT=y
CONFIG_SPI_BOOT=y
CONFIG_ENV_NOR=y
CONFIG_MTD=y
CONFIG_SPL_SPI_FLASH_SUPPORT=y
CONFIG_SPL_SPI_SUPPORT=y
CONFIG_SPI=y
CONFIG_SPI_FLASH=y
CONFIG_SPI_FLASH_SUPPORT=y
CONFIG_SPI_FLASH_SPANSION=y
CONFIG_SPI_FLASH_MACRONIX=y
CONFIG_CMD_NAND=y
CONFIG_SYS_MPUCLK=300
CONFIG_SPL_LDSCRIPT="arch/arm/mach-omap2/am33xx/u-boot-spl.lds"
CONFIG_OMAP3_SPI=y
CONFIG_BOARD_EARLY_INIT_F=y
CONFIG_HW_WATCHDOG=y
CONFIG_OMAP_WATCHDOG=y

CONFIG_AUTOBOOT_KEYED=n
CONFIG_BOOTDELAY=0
```
